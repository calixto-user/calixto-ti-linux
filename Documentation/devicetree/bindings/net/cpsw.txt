## Documentation/devicetree/bindings/net/cpsw.txt
```
TI SoC Ethernet Switch Controller Device Tree Bindings
------------------------------------------------------

Required properties:
- compatible		: Should be one of the below:-
			  "ti,cpsw" for backward compatible
			  "ti,am335x-cpsw" for AM335x controllers
			  "ti,am4372-cpsw" for AM437x controllers
			  "ti,dra7-cpsw" for DRA7x controllers
- reg			: physical base address and size of the cpsw
			  registers map
- interrupts		: property with a value describing the interrupt
			  number
- cpdma_channels 	: Specifies number of channels in CPDMA
- ale_entries		: Specifies No of entries ALE can hold
- bd_ram_size		: Specifies internal descriptor RAM size
- mac_control		: Specifies Default MAC control register content
			  for the specific platform
- slaves		: Specifies number for slaves
- active_slave		: Specifies the slave to use for time stamping,
			  ethtool and SIOCGMIIPHY
- cpsw-phy-sel		: Specifies the phandle to the CPSW phy mode selection
			  device. See also cpsw-phy-sel.txt for it's binding.
			  Note that in legacy cases cpsw-phy-sel may be
			  a child device instead of a phandle.

Optional properties:
- ti,hwmods		: Must be "cpgmac0"
- dual_emac		: Specifies Switch to act as Dual EMAC
- syscon		: Phandle to the system control device node, which is
			  the control module device of the am33x
- mode-gpios		: Should be added if one/multiple gpio lines are
			  required to be driven so that cpsw data lines
			  can be connected to the phy via selective mux.
			  For example in dra72x-evm, pcf gpio has to be
			  driven low so that cpsw slave 0 and phy data
			  lines are connected via mux.
- cpts_clock_mult	: Numerator to convert input clock ticks into nanoseconds
- cpts_clock_shift	: Denominator to convert input clock ticks into nanoseconds
			  Mult and shift will be calculated basing on CPTS
			  rftclk frequency if both cpts_clock_shift and
			  cpts_clock_mult properties are not provided.
- cpts-ext-ts-inputs	: The number of external time stamp channels.
			  The different CPTS versions might support up 8
			  external time stamp channels.
			  if absent - unsupported.

Slave Properties:
Required properties:
- phy-mode		: See ethernet.txt file in the same directory

Optional properties:
- dual_emac_res_vlan	: Specifies VID to be used to segregate the ports
- mac-address		: See ethernet.txt file in the same directory
- phy_id		: Specifies slave phy id (deprecated, use phy-handle)
- phy-handle		: See ethernet.txt file in the same directory
- pps_timer		: phandle, referring to the DM timer for PPS generation
- latch_timer	: phandle, phandle, referring to the DM timer for PPS latch
- pinctrl-names	: List of assigned state names,
				  see pinctrl binding documentation.
- pinctrl-0: phandle, referring to the PPS signal on configuration node.
- pinctrl-1: phandle, referring to the PPS signal off configuration node.
- pinctrl-2: phandle, referring to the PPS ref signal on configuration node.
- pinctrl-3: phandle, referring to the PPS ref signal off configuration node.
- pinctrl-4: phandle, referring to the PPS latch signal on configuration node.
- pinctrl-5: phandle, referring to the PPS latch signal off configuration node.
- pps-enable-gpios	: GPIO specifier, used to enable PPS signal output
- ref-enable-gpios	: GPIO specifier, used to enable PPS ref signal output
- cpts_pps_hw_event_index	: Specifies hw push event index for PPS timer <0-3>

Slave sub-nodes:
- fixed-link		: See fixed-link.txt file in the same directory

Note: Exactly one of phy_id, phy-handle, or fixed-link must be specified.

Note: "ti,hwmods" field is used to fetch the base address and irq
resources from TI, omap hwmod data base during device registration.
Future plan is to migrate hwmod data base contents into device tree
blob so that, all the required data will be used from device tree dts
file.

Examples:

	mac: ethernet@4a100000 {
		compatible = "ti,cpsw";
		reg = <0x4A100000 0x1000>;
		interrupts = <55 0x4>;
		interrupt-parent = <&intc>;
		cpdma_channels = <8>;
		ale_entries = <1024>;
		bd_ram_size = <0x2000>;
		rx_descs = <64>;
		mac_control = <0x20>;
		slaves = <2>;
		active_slave = <0>;
		cpts_clock_mult = <0x80000000>;
		cpts_clock_shift = <29>;
		syscon = <&cm>;
		cpsw-phy-sel = <&phy_sel>;
		cpsw_emac0: slave@0 {
			phy_id = <&davinci_mdio>, <0>;
			phy-mode = "rgmii-txid";
			/* Filled in by U-Boot */
			mac-address = [ 00 00 00 00 00 00 ];
		};
		cpsw_emac1: slave@1 {
			phy_id = <&davinci_mdio>, <1>;
			phy-mode = "rgmii-txid";
			/* Filled in by U-Boot */
			mac-address = [ 00 00 00 00 00 00 ];
		};
	};

(or)
	mac: ethernet@4a100000 {
		compatible = "ti,cpsw";
		ti,hwmods = "cpgmac0";
		cpdma_channels = <8>;
		ale_entries = <1024>;
		bd_ram_size = <0x2000>;
		rx_descs = <64>;
		mac_control = <0x20>;
		slaves = <2>;
		active_slave = <0>;
		cpts_clock_mult = <0x80000000>;
		cpts_clock_shift = <29>;
		syscon = <&cm>;
		cpsw-phy-sel = <&phy_sel>;
		cpsw_emac0: slave@0 {
			phy_id = <&davinci_mdio>, <0>;
			phy-mode = "rgmii-txid";
			/* Filled in by U-Boot */
			mac-address = [ 00 00 00 00 00 00 ];
		};
		cpsw_emac1: slave@1 {
			phy_id = <&davinci_mdio>, <1>;
			phy-mode = "rgmii-txid";
			/* Filled in by U-Boot */
			mac-address = [ 00 00 00 00 00 00 ];
		};
	};


(plus)
&mac {
	/* cptr pps1 generator and latch properties */
	pps_timer = <&timer16>;
	latch_timer = <&timer15>;
	pinctrl-names = "pwm_off", "pwm_on", "ref_off", "ref_on",
			"latch_on", "latch_off";
	pinctrl-0 = <&pps1_timer16_pwm_off>;
	pinctrl-1 = <&pps1_timer16_pwm_on>;
	pinctrl-2 = <&pps1_timer16_pwm2_off>;
	pinctrl-3 = <&pps1_timer16_pwm2_on>;
	pinctrl-4 = <&pps1_timer15_latch_on>;
	pinctrl-5 = <&pps1_timer15_latch_off>;

	pps-enable-gpios = <&gpio1 5 GPIO_ACTIVE_HIGH>;
	ref-enable-gpios = <&gpio6 19 GPIO_ACTIVE_HIGH>;
};
```

## Documentation/devicetree/bindings/net/ti-prueth.txt
```
Texas Instruments PRUSS Ethernet MAC
====================================

Required properties:
- compatible       : Should be one of the following,
                        "ti,am3359-prueth" for AM335x SoCs
                        "ti,am4376-prueth" for AM437x SoCs
                        "ti,am57-prueth" for AM57xx SoCs
                        "ti,k2g-prueth" for 66AK2G SoCs

- prus             : list of pHandles to the PRU nodes
- firmware-name	   : list of strings containing firmware path.
- sram	           : pHandle to OCMC SRAM node
- interrupt-parent : pHandle to the PRUSS INTC node
- mii-rt	   : pHandle to MII_RT module's syscon regmap
- iep		   : pHandle to IEP module's syscon regmap
- rx-queue-size    : Array of queue sizes in rx direction (Ingress)
                     Format /bits/ 16 <q1 q2 q3 q4>
                     Note that the queue size value (q1/q2/q3/q4)
                     has to be non-zero

    If no q size config exists for a particular port in
    dts, the following defaults for that port will
    be used.

    host: rx-queue-size = /bits/ 16 <194 194 194 194 0>
    mii0: tx-queue-size = /bits/ 16 <97 97 97 97 48>
    mii1: tx-queue-size = /bits/ 16 <97 97 97 97 48>

Optional properties:
- interrupt-names  : If enabling packet priority based interrupts for HSR/PRP,
		     should be "rx_red_hp", "rx_red_lp".
- interrupts       : should contain an array of PRUSS system event
                     numbers.
- pinctrl-names	: List of assigned state names,
				  see pinctrl binding documentation.
- pinctrl-0: phandle, referring to the SYNC0 signal on configuration node.
- pinctrl-1: phandle, referring to the SYNC0 signal off configuration node.
- pinctrl-2: phandle, referring to the LATCH0 signal on configuration node.
- pinctrl-3: phandle, referring to the LATCH0 signal off configuration node.

Must contain children, one for each of the MAC ports.
Children must be named ethernet-mii0 and ethernet-mii1.
Either one or both children can be present. If only one
child is present driver operates in single EMAC mode.

For single mode operation with the 2nd PRU, you still need
to provide both PRUs and firmware-names but the firmware-name
for the first PRU can be NULL. See 2nd example.

Required properties for children:
- phy-handle       : See ethernet.txt file in the same directory.
- phy-mode         : See ethernet.txt file in the same directory.
- interrupt-names  : should be "rx", "tx", "emac_ptp_tx", and "hsrprp_ptp_tx".
                     emac_ptp_tx and hsrprp_ptp_tx are optional.
- interrupts       : should contain an array of PRUSS system event
                     numbers used as the interrupt sources for Rx
                     Tx and PTP Tx event packet timestamping (with
                     PRP firmware) respectively.
- tx-queue-size    : Array of queue sizes in tx direction (Egress)
                     Format /bits/ 16 <q1 q2 q3 q4>.
                     Note that the queue size value (q1/q2/q3/q4) has
                     to be non-zero.

NOTE: When changing queue sizes, make sure that the sum of all queue
sizes across ingress or host (defined by rx-queue-size or default values
in the driver) and egress or mii0/1 ports (defined by port specific
tx-queue-size or default values in the driver) must be less than or
equal to 1552.

Optional properties for children:
- local-mac-address	: mac address for the port.

Example (am572x-idk board, dual-emac):
======================================
	pruss2_eth: pruss2_eth {
		compatible = "ti,am57-prueth";
		prus = <&pru2_0>, <&pru2_1>;
		firmware-name = "ti-pruss/am57xx-pru0-prueth-fw.elf",
				"ti-pruss/am57xx-pru1-prueth-fw.elf";
		sram = <&ocmcram1>;
		interrupt-parent = <&pruss2_intc>;
		mii-rt = <&pruss2_mii_rt>;
		iep = <&pruss2_iep>;

		pruss2_emac0: ethernet-mii0 {
			phy-handle = <&pruss2_eth0_phy>;
			phy-mode = "mii";
			interrupts = <20>, <22>, <23>, <26>;
			interrupt-names = "rx", "tx", "hsrprp_ptp_tx",
					  "emac_ptp_tx";
			/* Filled in by bootloader */
			local-mac-address = [00 00 00 00 00 00];
		};

		pruss2_emac1: ethernet-mii1 {
			phy-handle = <&pruss2_eth1_phy>;
			phy-mode = "mii";
			interrupts = <21>, <23>, <24>, <27>;
			interrupt-names = "rx", "tx", "hsrprp_ptp_tx",
					  "emac_ptp_tx";
			/* Filled in by bootloader */
			local-mac-address = [00 00 00 00 00 00];
		};
	};

Example (am572x-idk board, single-emac):
=======================================
	pruss2_eth: pruss2_eth {
		compatible = "ti,am57-prueth";
		prus = <&pru2_0>, <&pru2_1>;
		firmware-name = "",
				"ti-pruss/am57xx-pru1-prueth-fw.elf";
		sram = <&ocmcram1>;
		interrupt-parent = <&pruss2_intc>;
		mii-rt = <&pruss2_mii_rt>;
		iep = <&pruss2_iep>;

		pruss2_emac1: ethernet-mii1 {
			phy-handle = <&pruss2_eth1_phy>;
			phy-mode = "mii";
			interrupts = <21>, <23>, <24>, <27>;
			interrupt-names = "rx", "tx", "hsrprp_ptp_tx",
					  "emac_ptp_tx";
			/* Filled in by bootloader */
			local-mac-address = [00 00 00 00 00 00];
		};
	};


Example (am572x-idk board, SYNC/LATCH configurations):
======================================================
&pruss2_eth {
	pinctrl-names = "sync0_off", "sync0_on", "latch0_off", "latch0_on";
	pinctrl-0 = <&pr2_edc_sync0_off>;
	pinctrl-1 = <&pr2_edc_sync0_on>;
	pinctrl-2 = <&pr2_edc_latch0_off>;
	pinctrl-3 = <&pr2_edc_latch0_on>;
};
```

## Documentation/devicetree/bindings/net/ti-ptp-bc.txt
```
Texas Instruments PTP Boundary Clcok Internal Sync Monitor
==========================================================

Required properties:
- compatible       : Should be
                        "ti,am57-bc" for AM57xx SoCs
Optional properties:
- pps-sel0-gpios	: GPIO specifier, used to select PPS BC mux output
- pps-sel1-gpios	: GPIO specifier, used to select PPS BC mux output

Example:
========

In am57xx-idk-common.dts
	ptp_bc: ptp_bc {
		compatible = "ti,am57-bc";
		status = "disabled";
	};

To enable for am572x-idk, in am572x-idk.dts:

&ptp_bc {
	status = "okay";
};

To enable for am571x-idk-pps, in am572x-idk-pps.dtso:

&ptp_bc {
	pps-sel0-gpios = <&gpio1 4 GPIO_ACTIVE_HIGH>;
	pps-sel1-gpios = <&gpio6 7 GPIO_ACTIVE_HIGH>;

	status = "okay";
};
```
